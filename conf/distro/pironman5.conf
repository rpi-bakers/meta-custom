## conf/distro/pironman5.conf
```bitbake
require conf/distro/rpi-build.conf

###############################################################################
# enable pironman5 mini pc case support for only raspberry pi 5
DISTRO_FEATURES:append:raspberrypi5 = " pironman5"

###############################################################################
IMAGE_INSTALL:append:raspberrypi5 = " \
    python3-pironman5 \
    python3-pm-auto \
    python3-pm-dashboard \
    python3-sf-rpi-status \
    lgpio \
    \
    python3-gpiozero \
    lirc \
"

###############################################################################
# raspberry pi config parameters
# meta-raspberrypi\recipes-bsp\bootfiles\rpi-config_git.bb
# meta-raspberrypi\recipes-bsp\bootfiles\rpi-cmdline.bb
ENABLE_UART:raspberrypi5 = "1"
ENABLE_SPI_BUS:raspberrypi5 = "1"
ENABLE_I2C:raspberrypi5 = "1"
ENABLE_IR:raspberrypi5 = "1"
GPIO_IR:raspberrypi5 = "13"
```

## conf/layer.conf
```bitbake
# We have a conf and classes directory, add to BBPATH
BBPATH .= ":${LAYERDIR}"

# We have a recipes directory, add to BBFILES
BBFILES += "${LAYERDIR}/*/*/*.bb \
            ${LAYERDIR}/*/*/*.bbappend"


BBFILE_COLLECTIONS += "custom"
BBFILE_PATTERN_custom := "^${LAYERDIR}/"
BBFILE_PRIORITY_custom = "45"

LAYERSERIES_COMPAT_custom = "scarthgap"
```
