## conf/distro/rpi-build-u-boot.conf
```bitbake
require conf/distro/rpi-build.conf

DISTRO = "rpi-build-u-boot"

###############################################################################
## use u-boot on raspberry pi
RPI_USE_U_BOOT = "1"
PREFERRED_PROVIDER_virtual/bootloader = "u-boot"

###############################################################################
# FIT image kernel booting parameters
KERNEL_CLASSES += "kernel-fitimage"
KERNEL_IMAGETYPE_UBOOT = "fitImage"
KERNEL_BOOTCMD = "bootm"

###############################################################################
## Device Tree for FIT Image
RPI_KERNEL_DEVICETREE:raspberrypi3 = " broadcom/bcm2710-rpi-3-b.dtb "
RPI_KERNEL_DEVICETREE:raspberrypi3-64 = " broadcom/bcm2710-rpi-3-b.dtb "
RPI_KERNEL_DEVICETREE:raspberrypi5 = " broadcom/bcm2712-rpi-5-b.dtb "
```
